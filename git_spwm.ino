
#include <avr/io.h>
#include <avr/interrupt.h>
#include <avr/pgmspace.h>

static const byte lookUp[] PROGMEM = {
  0, 2, 5, 7, 10, 12, 14, 17, 19, 22,  //0
  24, 27, 29, 31, 34, 36, 38, 40, 42, 44,
  47, 49, 50, 52, 54, 56, 58, 59, 61, 63,
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  242, 244, 246, 248, 250, 251, 252, 253, 254, 255  //1799
};
char Lim, En=0, pwm;
int Sinl = 0, Sinh = 49, H;
const char timee = 94;//magic number for 50Hz on 16MHz qartz
void setup() {
cli();

    TCCR1A = _BV(COM1A1) | _BV(COM1B1) | _BV(WGM10);
   
  TCCR1B = _BV(CS10);
  
DDRB = _BV(PB1) | _BV(PB2)
DDRB = _BV(PB5);
 
pinMode(9, OUTPUT);
pinMode(10, OUTPUT); 
pinMode(13, INPUT); //push button start/stop
pinMode(A2, INPUT);//accumulator status
pinMode(A1, INPUT);//high voltage feedback
sei();  
}

void loop() 
{
startt:
  Lim = 0;
  En = 1;
  delay(200);
_while:  
  int Acpl = analogRead(A2);
  if ((Acpl< 315) | (Acpl > 881)) {
    Slep();  
    goto startt;
  }
  for (H = Sinl; H < Sinh; H++) {
    pwm = pgm_read_byte(&lookUp[H]);
    OCR1AL = pwm;
    OCR1BL = 0;
    delayMicroseconds(timee);
    if (digitalRead(13) == LOW) Lim++;
    if (Lim >= 10){Slep(); goto startt;}
  }
    for (H = Sinh; H > Sinl; H--) {
    pwm = pgm_read_byte(&lookUp[H]);
    OCR1AL = pwm;
    OCR1BL = 0;
    delayMicroseconds(timee);
    if (digitalRead(13) == LOW) Lim++;
    if (Lim >= 10) {Slep(); goto startt;}
}
for (H = Sinl; H < Sinh; H++) {
    pwm = pgm_read_byte(&lookUp[H]);
    OCR1AL = 0;
    OCR1BL = pwm;
    delayMicroseconds(timee);
    if (digitalRead(13) == LOW) Lim++;
    if (Lim >= 10) {Slep(); goto startt;}
  }
    for (H = Sinh; H > Sinl; H--) {
    pwm = pgm_read_byte(&lookUp[H]);
    OCR1AL = 0;
    OCR1BL = pwm;
    delayMicroseconds(timee);
    if (digitalRead(13) == LOW) Lim++;
    if (Lim >= 10) {Slep(); goto startt;}
}
int Acph = analogRead(A1);
    if((Acph >= 550) & (Sinl > 49))
        {
          Sinh -= 50;
          Sinl -= 50;
        }
if((Acph <= 540) & (Sinh < 1799))
        {
          Sinh += 50;
          Sinl += 50;
        }  
goto _while;
}
void Slep() {
  Lim = 0;
  do {
    En = 0;
    OCR1AL = 0;
    OCR1BL = 0;
    delayMicroseconds(200);
  } while (digitalRead(13) != HIGH);
  Sinl = 0;
  Sinh = 49;
  H = 0;

  do { delay(200); } while (digitalRead(13) != HIGH);
  do { delay(200); } while (digitalRead(13) != LOW);
  do { delay(200); } while (digitalRead(13) != HIGH);
  
}
